## main/Kconfig.projbuild
```kconfig
menu "MacroPad Configuration"

config MACROPAD_WIFI_SSID
    string "Wi-Fi SSID"
    default ""
    help
        Wi-Fi SSID for SNTP time synchronization. Leave empty to disable Wi-Fi.

config MACROPAD_WIFI_PASSWORD
    string "Wi-Fi Password"
    default ""
    help
        Wi-Fi password for SNTP time synchronization.

config MACROPAD_NTP_SERVER
    string "NTP Server"
    default "pool.ntp.org"
    help
        SNTP server hostname used to synchronize system time.

config MACROPAD_TZ
    string "Timezone (TZ env format)"
    default "UTC0"
    help
        Timezone string in POSIX TZ format, e.g. CST-8, EST5EDT,M3.2.0/2,M11.1.0/2.

config MACROPAD_HA_BASE_URL
    string "Home Assistant Base URL"
    default ""
    help
        Home Assistant base URL used by the REST event bridge, e.g.
        http://homeassistant.local:8123

config MACROPAD_HA_BEARER_TOKEN
    string "Home Assistant Bearer Token"
    default ""
    help
        Long-lived access token used as Authorization: Bearer <token>.
        Keep empty to disable authenticated requests.

config MACROPAD_WEB_API_KEY
    string "Web Service API Key (X-API-Key header)"
    default ""
    help
        API key required by the local web service when non-empty.
        Sent by clients as HTTP header: X-API-Key: <value>.
        Leave empty to disable API-key authentication.

config MACROPAD_WEB_BASIC_AUTH_USER
    string "Web Service Basic Auth Username"
    default ""
    help
        Basic Auth username for local web service.
        Basic Auth is enabled only when both username and password are non-empty.
        Leave empty to disable Basic Auth.

config MACROPAD_WEB_BASIC_AUTH_PASSWORD
    string "Web Service Basic Auth Password"
    default ""
    help
        Basic Auth password for local web service.
        Basic Auth is enabled only when both username and password are non-empty.
        Leave empty to disable Basic Auth.

config MACROPAD_OTA_DEFAULT_URL
    string "Default OTA URL (HTTP/HTTPS)"
    default ""
    help
        Optional default firmware URL for OTA endpoint.
        Used when /api/v1/system/ota is called without a URL payload.

config MACROPAD_OTA_HTTP_TIMEOUT_MS
    int "OTA HTTP Timeout (ms)"
    default 15000
    range 2000 120000
    help
        HTTP timeout for OTA download requests.

config MACROPAD_BLE_DEVICE_NAME
    string "BLE Device Name"
    default "ESP32 MacroPad BLE"
    help
        BLE HID device name shown during pairing.

config MACROPAD_BLE_PASSKEY
    int "BLE Static Passkey"
    default 123456
    range 0 999999
    help
        BLE passkey used for pairing when passkey input is requested.
        Set to 0 to enable random 6-digit passkey generation per pairing window.

config MACROPAD_BLE_TX_POWER
    int "BLE TX Power (dBm)"
    default 9
    range -12 9
    help
        Preferred BLE TX power. Current backend keeps controller defaults;
        value is reserved for future dynamic power tuning.

endmenu
```

## sdkconfig.defaults
```kconfig
CONFIG_IDF_TARGET="esp32s3"
CONFIG_TINYUSB_CDC_ENABLED=y
CONFIG_TINYUSB_HID_COUNT=1
CONFIG_TINYUSB_DESC_CUSTOM_VID=0x303A
CONFIG_TINYUSB_DESC_CUSTOM_PID=0x4010
CONFIG_LOG_DEFAULT_LEVEL_INFO=y
CONFIG_ESP_CONSOLE_UART_DEFAULT=y
CONFIG_ESP_CONSOLE_SECONDARY_USB_SERIAL_JTAG=y
CONFIG_ESP_CONSOLE_USB_SERIAL_JTAG_ENABLED=y

# Target performance and flash layout defaults
CONFIG_ESPTOOLPY_FLASHSIZE_8MB=y
CONFIG_PARTITION_TABLE_CUSTOM=y
CONFIG_PARTITION_TABLE_CUSTOM_FILENAME="partitions_8mb_ota.csv"
CONFIG_PARTITION_TABLE_FILENAME="partitions_8mb_ota.csv"
CONFIG_ESP_DEFAULT_CPU_FREQ_MHZ_240=y
CONFIG_ESP_DEFAULT_CPU_FREQ_MHZ=240
CONFIG_COMPILER_OPTIMIZATION_PERF=y
CONFIG_COMPILER_OPTIMIZATION_ASSERTIONS_DISABLE=y
CONFIG_COMPILER_OPTIMIZATION_ASSERTION_LEVEL=0
CONFIG_BOOTLOADER_APP_ROLLBACK_ENABLE=y
CONFIG_MACROPAD_HA_BASE_URL=""
CONFIG_MACROPAD_HA_BEARER_TOKEN=""
CONFIG_MACROPAD_OTA_DEFAULT_URL=""
CONFIG_MACROPAD_OTA_HTTP_TIMEOUT_MS=15000
CONFIG_ESP_HTTPS_OTA_ALLOW_HTTP=y
CONFIG_ESP_TLS_INSECURE=y
CONFIG_ESP_TLS_SKIP_SERVER_CERT_VERIFY=y

# BLE HID keyboard support
CONFIG_BT_ENABLED=y
CONFIG_BT_BLUEDROID_ENABLED=y
CONFIG_BT_BLE_ENABLED=y
CONFIG_BT_HID_ENABLED=y
CONFIG_BT_HID_DEVICE_ENABLED=y
CONFIG_BT_BLE_42_FEATURES_SUPPORTED=y
```
